## drivers/net/wireless/bcmdhd.1.201.34.x.cn/Kconfig
```kconfig
config BCMDHD_AP6330
	tristate "Broadcom FullMAC wireless cards support"
	depends on MMC
	default m	
	---help---
	  This module adds support for wireless adapters based on
	  Broadcom FullMAC chipset(AP6330).

config BCMDHD_AP6330_FW_PATH
	depends on BCMDHD_AP6330
	string "Firmware path"
	default "/etc/firmware/fw_bcmdhd.bin"
	---help---
	  Path to the firmware file.

config BCMDHD_AP6330_NVRAM_PATH
	depends on BCMDHD_AP6330
	string "NVRAM path"
	default "/etc/firmware/nvram.txt"
	---help---
	  Path to the calibration file.

config BCMDHD_AP6330_CONFIG_PATH
	depends on BCMDHD_AP6330
	string "Config path"
	default "/etc/firmware/config.txt"
	---help---
	  Path to the driver configuration file.

config BCMDHD_AP6330_WEXT
	bool "Enable WEXT support"
	depends on BCMDHD_AP6330 && CFG80211 = n
	select WIRELESS_EXT
	select WEXT_PRIV
	help
	  Enables WEXT support

choice
	depends on BCMDHD_AP6330
	prompt "Interrupt type"
	---help---
	  Interrupt type
config BCMDHD_AP6330_OOB
	depends on BCMDHD_AP6330
	bool "Out-of-Band Interrupt"
#	default y
	---help---
	  Interrupt from WL_HOST_WAKE.
config BCMDHD_AP6330_SDIO_IRQ
	depends on BCMDHD_AP6330
	bool "In-Band Interrupt"
	#default y	
	---help---
	  Interrupt from SDIO DAT[1]
endchoice
```

## drivers/net/wireless/bcmdhd.1.88.45.x.cn/Kconfig
```kconfig
config BCMDHD_1_88_45
	tristate "Broadcom 4329/30 (Driver Rev1.88.45) wireless cards support"
	depends on MMC
	---help---
	  This module adds support for wireless adapters based on
	  Broadcom 4329/30 chipset.

config BCMDHD_1_88_45_FW_PATH
	depends on BCMDHD_1_88_45
	string "Firmware path"
	default "/etc/firmware/fw_bcmdhd.bin"
	---help---
	  Path to the firmware file.

config BCMDHD_1_88_45_NVRAM_PATH
	depends on BCMDHD_1_88_45
	string "NVRAM path"
	default "/etc/firmware/nvram.txt"
	---help---
	  Path to the calibration file.

config BCMDHD_1_88_45_CONFIG_PATH
	depends on BCMDHD_1_88_45
	string "Config path"
	default "/etc/firmware/config.txt"
	---help---
	  Path to the driver configuration file.

config BCMDHD_1_88_45_WEXT
	bool "Enable WEXT support"
	depends on BCMDHD_1_88_45 && CFG80211 = n
	select WIRELESS_EXT
	select WEXT_PRIV
	help
	  Enables WEXT support

config BCMDHD_1_88_45_INSERT_MAC
	bool "Enable insert MAC support"
	depends on BCMDHD_1_88_45
	---help---
	  Enable insert MAC from insert module support

config BCMDHD_1_88_45_PRIO_OVERRIDE
	bool "Enable DSCP/WMM priority override"
	depends on BCMDHD_1_88_45
	---help---
	  Enable DSCP/WMM priority override by BCM setting

choice
	depends on BCMDHD_1_88_45
	prompt "Interrupt type"
	---help---
	  Interrupt type
config BCMDHD_1_88_45_OOB
	depends on BCMDHD_1_88_45
	bool "Out-of-Band Interrupt"
	#default n
	---help---
	  Interrupt from WL_HOST_WAKE.
config BCMDHD_1_88_45_SDIO_IRQ
	depends on  BCMDHD_1_88_45
	bool "In-Band Interrupt"
	default y
	---help---
	  Interrupt from SDIO DAT[1]
endchoice
```

## drivers/video/ait/Kconfig
```kconfig
config FB_AIT
        tristate "AIT frame buffer support"
        depends on FB
        select FB_SYS_FILLRECT
        select FB_SYS_COPYAREA
        select FB_SYS_IMAGEBLIT
        select FB_SYS_FOPS

config FB_AIT_RGBLCD
        tristate "AIT RGB-type LCD frame buffer support"
        depends on FB_AIT

config IC_ILI8961
        tristate "ALC027A(ILI8961)"
        depends on FB_AIT_RGBLCD
```

## net/bluetooth_3_5_0/Kconfig
```kconfig
#
# Bluetooth subsystem configuration
#

menuconfig BT
	tristate "Bluetooth subsystem support (linux-3.2.7)"
	depends on NET && !S390
	depends on RFKILL || !RFKILL
	select CRC16
	select CRYPTO
	select CRYPTO_BLKCIPHER
	select CRYPTO_AES
	select CRYPTO_ECB
	help
	  Bluetooth is low-cost, low-power, short-range wireless technology.
	  It was designed as a replacement for cables and other short-range
	  technologies like IrDA.  Bluetooth operates in personal area range
	  that typically extends up to 10 meters.  More information about
	  Bluetooth can be found at <http://www.bluetooth.com/>.

	  Linux Bluetooth subsystem consist of several layers:
	     Bluetooth Core
		HCI device and connection manager, scheduler
		SCO audio links
		L2CAP (Logical Link Control and Adaptation Protocol)
		SMP (Security Manager Protocol) on LE (Low Energy) links
	     HCI Device drivers (Interface to the hardware)
	     RFCOMM Module (RFCOMM Protocol)  
	     BNEP Module (Bluetooth Network Encapsulation Protocol)
	     CMTP Module (CAPI Message Transport Protocol)
	     HIDP Module (Human Interface Device Protocol)

	  Say Y here to compile Bluetooth support into the kernel or say M to
	  compile it as module (bluetooth).

	  To use Linux Bluetooth subsystem, you will need several user-space
	  utilities like hciconfig and bluetoothd.  These utilities and updates
	  to Bluetooth kernel modules are provided in the BlueZ packages.  For
	  more information, see <http://www.bluez.org/>.

if BT != n

config BT_L2CAP
	bool "L2CAP protocol support"
	select CRC16
	select CRYPTO
	select CRYPTO_BLKCIPHER
	select CRYPTO_AES
	select CRYPTO_ECB
	help
	  L2CAP (Logical Link Control and Adaptation Protocol) provides
	  connection oriented and connection-less data transport.  L2CAP
	  support is required for most Bluetooth applications.

	  Also included is support for SMP (Security Manager Protocol) which
	  is the security layer on top of LE (Low Energy) links.

config BT_SCO
	bool "SCO links support"
	help
	  SCO link provides voice transport over Bluetooth.  SCO support is
	  required for voice applications like Headset and Audio.

endif

source "net/bluetooth_3_5_0/rfcomm/Kconfig"

source "net/bluetooth_3_5_0/bnep/Kconfig"

source "net/bluetooth_3_5_0/cmtp/Kconfig"

source "net/bluetooth_3_5_0/hidp/Kconfig"

source "drivers/bluetooth_3_5_0/Kconfig"
```

## sound/soc/mcrv2aud/Kconfig
```kconfig
choice 
	prompt "Soc Audio for MCRV2 built-in codec"

config SND_MCRV2_SOC_I2S
	tristate "Audio I2S support"

if SND_MCRV2_SOC_I2S
config SND_MCRV2_SOC_I2S_IF0
	tristate "Audio I2S controller 0 Interface support"
	depends on SND_MCRV2_SOC_I2S
	default Y
	help
	  This selects the I2S controller 0.

	  If unsure, say Y.

config SND_MCRV2_SOC_I2S_IF1
	tristate "Audio I2S controller 1 Interface support"
	depends on SND_MCRV2_SOC_I2S
	help
	  This selects the MMC controller 1.

	  If unsure, say Y.

endif #SND_MCRV2_SOC_I2S

config SND_MCRV2_SOC_ALSA
        tristate "Standard ADC/DAC support"
	depends on ARCH_MCRV2 || AIT_CHIP_MCR_V2
	default y
	help
	  Say Y if you want to add support for SoC audio on AIT8428 evaluation board.

config SND_MCRV2_SOC_ALSA_ALG_ENH
        tristate "Audio Algorithm Enhanced"
	depends on ARCH_MCRV2 || AIT_CHIP_MCR_V2 && CONFIG_AIT_MCRV2_DUAL_OS_ON_CPUA
	default y
	help
	  Say Y if you want to add support for SoC audio on AIT8428 built-in codec.

endchoice
```

## sound/soc/vsnv3aud/Kconfig
```kconfig
config SND_AIT_SOC
        tristate "SoC Audio for the AIT8455 System-on-Chip"
	depends on ARCH_VSNV3 
	help
	  Say Y or M if you want to add support for codecs attached to
	  the ATMEL SSC interface. You will also need
	  to select the audio interfaces to support below.

config SND_AIT_SOC_SSC
	tristate
	depends on SND_AIT_SOC
	default y
	help
	  Say Y or M if you want to add support for codecs the
	  ATMEL SSC interface. You will also needs to select the individual
	  machine drivers to support below.

config SND_AIT8455_SOC_ALSA
        tristate "SoC Audio support for AIT8455 evaluation board"
	depends on ARCH_VSNV3
	select SND_AIT_SOC_SSC
	default y
	help
	  Say Y if you want to add support for SoC audio on AIT8455 evaluation board.

config SND_VSNV3_SOC_AIT8455_WM8973
          tristate "SoC Audio support for WM8731-based AIT8455 evaluation board"
          depends on ARCH_VSNV3 && SND_AIT_SOC_SSC && SND_AIT_SOC
          select SND_SOC_WM8973
          default y
          help
            Say Y if you want to add support for SoC audio on WM8731-based
            AIT8455 evaluation board.
 
config SND_VSNV3_SOC_AIT8455_RT5627
          tristate "SoC Audio support for RT5627-based AIT8455 evaluation board"
          depends on ARCH_VSNV3 && SND_AIT_SOC_SSC && SND_AIT_SOC
          select SND_SOC_RT5627
          help
            Say Y if you want to add support for SoC audio on RT5627-based
            AIT8455 evaluation board.
```
