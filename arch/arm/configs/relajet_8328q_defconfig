## arch/arm/configs/relajet_8328q_defconfig
```kconfig
# CONFIG_ARM_PATCH_PHYS_VIRT is not set
CONFIG_PHYS_OFFSET=0x01000000
CONFIG_EXPERIMENTAL=y
CONFIG_CROSS_COMPILE="/opt/buildroot-vsnv3_2014q1/bin/arm-linux-"
# CONFIG_LOCALVERSION_AUTO is not set
CONFIG_KERNEL_LZO=y
# CONFIG_SWAP is not set
CONFIG_SYSVIPC=y
CONFIG_RCU_TRACE=y
CONFIG_IKCONFIG=m
CONFIG_IKCONFIG_PROC=y
CONFIG_NAMESPACES=y
CONFIG_BLK_DEV_INITRD=y
# CONFIG_RD_GZIP is not set
CONFIG_CC_OPTIMIZE_FOR_SIZE=y
CONFIG_SYSCTL_SYSCALL=y
CONFIG_KALLSYMS_ALL=y
CONFIG_EMBEDDED=y
CONFIG_SLAB=y
CONFIG_MODULES=y
CONFIG_MODULE_FORCE_LOAD=y
CONFIG_MODULE_UNLOAD=y
CONFIG_MODULE_FORCE_UNLOAD=y
CONFIG_MODULE_SRCVERSION_ALL=y
# CONFIG_LBDAF is not set
# CONFIG_BLK_DEV_BSG is not set
# CONFIG_IOSCHED_DEADLINE is not set
# CONFIG_IOSCHED_CFQ is not set
CONFIG_ARCH_MCRV2=y
CONFIG_AIT_MCRV2_DUAL_OS_ON_CPUA=y
CONFIG_AIT_ENABLE_JTAG=y
CONFIG_AIT_FAST_BOOT=y
CONFIG_AIT_VIDEO_RESERVED_MBYTE=64
CONFIG_AIT_EARLY_USART0=y
CONFIG_AEABI=y
CONFIG_LEDS=y
CONFIG_LEDS_CPU=y
CONFIG_USE_OF=y
CONFIG_ZBOOT_ROM_TEXT=0x0
CONFIG_ZBOOT_ROM_BSS=0x0
CONFIG_CMDLINE="quiet lpj=1314816 mem=240M console=ttyS0,115200 rootfstype=squashfs init=/init root=1f02 mtdparts=spi0.0:1M(boot),4M(kernel),4M(rootfs0),1M(jffs2),4M(rootfs1),1M(embedded),128K(nvram),64K(OEM),64K(Factory),768K(config),7M(iva);"
CONFIG_KEXEC=y
CONFIG_CRASH_DUMP=y
CONFIG_FPE_NWFPE=y
CONFIG_NET=y
CONFIG_PACKET=y
CONFIG_UNIX=y
CONFIG_INET=y
CONFIG_INET_XFRM_MODE_TRANSPORT=m
CONFIG_INET_XFRM_MODE_TUNNEL=m
CONFIG_INET_XFRM_MODE_BEET=m
CONFIG_INET_LRO=m
CONFIG_INET_DIAG=m
# CONFIG_IPV6 is not set
# CONFIG_BT_BLE_3_14_25 is not set
# CONFIG_WIRELESS is not set
CONFIG_DEVTMPFS=y
CONFIG_DEVTMPFS_MOUNT=y
CONFIG_MTD=y
CONFIG_MTD_TESTS=m
CONFIG_MTD_CMDLINE_PARTS=y
CONFIG_MTD_AFS_PARTS=y
CONFIG_MTD_CHAR=y
CONFIG_MTD_BLOCK=y
CONFIG_FTL=y
CONFIG_NFTL=y
CONFIG_MTD_CFI=y
CONFIG_MTD_JEDECPROBE=y
CONFIG_MTD_CFI_ADV_OPTIONS=y
CONFIG_MTD_CFI_LE_BYTE_SWAP=y
CONFIG_MTD_CFI_GEOMETRY=y
# CONFIG_MTD_MAP_BANK_WIDTH_2 is not set
# CONFIG_MTD_MAP_BANK_WIDTH_4 is not set
CONFIG_MTD_M25P80=y
CONFIG_MTD_BLOCK2MTD=y
CONFIG_MTD_NAND=y
CONFIG_PROC_DEVICETREE=y
CONFIG_BLK_DEV_RAM=y
CONFIG_BLK_DEV_RAM_COUNT=1
CONFIG_BLK_DEV_RAM_SIZE=28672
CONFIG_MISC_DEVICES=y
CONFIG_AIT_SSC=y
CONFIG_NETDEVICES=y
CONFIG_MII=m
# CONFIG_ETHERNET is not set
# CONFIG_WLAN is not set
CONFIG_INPUT=m
# CONFIG_INPUT_MOUSEDEV is not set
CONFIG_INPUT_EVDEV=m
# CONFIG_KEYBOARD_ATKBD is not set
CONFIG_KEYBOARD_GPIO=m
# CONFIG_INPUT_MOUSE is not set
CONFIG_SERIO=m
CONFIG_SERIO_LIBPS2=m
# CONFIG_VT is not set
# CONFIG_UNIX98_PTYS is not set
# CONFIG_LEGACY_PTYS is not set
# CONFIG_DEVKMEM is not set
CONFIG_SERIAL_AIT_CONSOLE=y
# CONFIG_HW_RANDOM is not set
CONFIG_I2C=m
CONFIG_I2C_CHARDEV=m
CONFIG_I2C_MUX=m
CONFIG_I2C_VSNV3=m
CONFIG_SPI=y
CONFIG_SPI_AIT=y
CONFIG_SPI_AIT_SIF=y
CONFIG_SPI_AIT_PSPI=y
CONFIG_SPI_SPIDEV=m
CONFIG_GPIO_SYSFS=y
# CONFIG_HWMON is not set
CONFIG_WATCHDOG=y
CONFIG_WATCHDOG_CORE=y
CONFIG_WATCHDOG_NOWAYOUT=y
CONFIG_SOFT_WATCHDOG=y
CONFIG_MEDIA_SUPPORT=y
CONFIG_VIDEO_DEV=m
# CONFIG_RC_CORE is not set
CONFIG_SOUND=y
CONFIG_SND=y
# CONFIG_SND_ARM is not set
CONFIG_SND_SOC=m
# CONFIG_SND_MCRV2_SOC_ALSA_ALG_ENH is not set
# CONFIG_HID_SUPPORT is not set
# CONFIG_USB_SUPPORT is not set
CONFIG_MMC=y
CONFIG_MMC_CLKGATE=y
CONFIG_MMC_SDHCI=y
CONFIG_MMC_AIT=y
CONFIG_MMC_AIT_IF0=y
CONFIG_CPU_SHARE_MEM=y
CONFIG_CPU_SHARE_MEM_TEST=m
CONFIG_EXT2_FS=m
CONFIG_EXT2_FS_XATTR=y
CONFIG_EXT2_FS_POSIX_ACL=y
CONFIG_EXT2_FS_SECURITY=y
CONFIG_EXT2_FS_XIP=y
CONFIG_EXT4_FS=m
# CONFIG_DNOTIFY is not set
# CONFIG_INOTIFY_USER is not set
CONFIG_MSDOS_FS=y
CONFIG_VFAT_FS=y
CONFIG_FAT_DEFAULT_IOCHARSET="utf8"
CONFIG_TMPFS=y
CONFIG_JFFS2_FS=m
CONFIG_JFFS2_FS_WBUF_VERIFY=y
CONFIG_SQUASHFS=y
# CONFIG_SQUASHFS_ZLIB is not set
CONFIG_SQUASHFS_LZO=y
CONFIG_SQUASHFS_XZ=y
# CONFIG_NETWORK_FILESYSTEMS is not set
CONFIG_NLS_DEFAULT="utf8"
CONFIG_NLS_CODEPAGE_437=y
CONFIG_NLS_UTF8=y
CONFIG_PRINTK_TIME=y
CONFIG_DEFAULT_MESSAGE_LOGLEVEL=1
CONFIG_MAGIC_SYSRQ=y
CONFIG_UNUSED_SYMBOLS=y
CONFIG_DEBUG_FS=y
CONFIG_HEADERS_CHECK=y
CONFIG_DEBUG_SECTION_MISMATCH=y
CONFIG_DEBUG_SHIRQ=y
CONFIG_LOCKUP_DETECTOR=y
# CONFIG_DETECT_HUNG_TASK is not set
CONFIG_SCHEDSTATS=y
CONFIG_DEBUG_RT_MUTEXES=y
CONFIG_DEBUG_INFO=y
CONFIG_DEBUG_MEMORY_INIT=y
CONFIG_DEBUG_LIST=y
CONFIG_TEST_LIST_SORT=y
CONFIG_DEBUG_SG=y
CONFIG_DEBUG_NOTIFIERS=y
CONFIG_DEBUG_CREDENTIALS=y
CONFIG_BOOT_PRINTK_DELAY=y
CONFIG_SYSCTL_SYSCALL_CHECK=y
CONFIG_TEST_KSTRTOX=y
CONFIG_DEBUG_USER=y
CONFIG_DEBUG_LL=y
CONFIG_EARLY_PRINTK=y
CONFIG_CRYPTO_ECB=m
CONFIG_CRYPTO_SHA256=m
CONFIG_CRYPTO_AES=m
# CONFIG_CRYPTO_ANSI_CPRNG is not set
# CONFIG_CRYPTO_HW is not set
CONFIG_CRC_ITU_T=m
CONFIG_CRC7=m
# CONFIG_XZ_DEC_X86 is not set
# CONFIG_XZ_DEC_POWERPC is not set
# CONFIG_XZ_DEC_IA64 is not set
# CONFIG_XZ_DEC_ARM is not set
# CONFIG_XZ_DEC_ARMTHUMB is not set
# CONFIG_XZ_DEC_SPARC is not set
```

## arch/arm/mach-mcrv2/Kconfig
```kconfig
if ARCH_MCRV2

menu "AIT MMP System-on-Chip"



choice
    prompt "AIT CHIP Name"

config MACH_MCRV2_6366
    bool "AIT6366 SOC"
    select CPU_ARM926T
    select GENERIC_CLOCKEVENTS
    select HAVE_NET_MACB
    select WIRELESS_EXT
    select WEXT_PRIV

config MACH_MCRV2_8428
    bool "AIT8428 SOC"
    select CPU_ARM926T
    select GENERIC_CLOCKEVENTS
    select HAVE_NET_MACB
    select WIRELESS_EXT
    select WEXT_PRIV

endchoice

# ----------------------------------------------------------

choice
	prompt "Select board"

config MCRV2_AIT6366G_EVB
    bool "AIT6366G Ext. DDR3 EVB "
    help
	Select this if you are using AIT's AIT6366G w/ ext. DDR3 Evaluation Kit

config MCRV2_AIT8428G_HDK
    bool "AIT8428G Ext. DDR3 HDK "
    help
	Select this if you are using AIT's AIT8428G w/ ext. DDR3 Evaluation Kit

config MCRV2_AIT8428EVB
    bool "AIT8428EVB Evaluation Kit"

	  
config MCRV2_LOT8428EVB
    bool "LOT8428EVB Evaluation Kit"

endchoice
	  

#------------------------


# ----------------------------------------------------------

comment "MCRV2 Feature Selections"

source "arch/arm/mach-mcrv2/cpucomm/Kconfig"


config AIT_ENABLE_JTAG
	bool "Enable JTAG"
	help
	  Select this if you need enable JTAG support.	

config AIT_FAST_BOOT
	bool "Enable Fast Boot"
	help
	  Select this if you need enable fast boot.		  

config AIT_CONSOLE_QUIET
	bool "Minimize Console Message"
	help
	  Select this if you need fast boot.		  

# ----------------------------------------------------------

comment "MCRV2 Feature Selections"

config AIT_TIMER_HZ
       int "Kernel HZ (jiffies per second)"
       range 32 1024
      # depends on ARCH_VSNV3
       default "100"
       help
	  On AT91rm9200 chips where you're using a system clock derived
	  from the 32768 Hz hardware clock, this tick rate should divide
	  it exactly: use a power-of-two value, such as 128 or 256, to
	  reduce timing errors caused by rounding.

	  On AT91sam926x chips, or otherwise when using a higher precision
	  system clock (of at least several MHz), rounding is less of a
	  problem so it can be safer to use a decimal values like 100.
	  
config AIT_VIDEO_RESERVED_MBYTE
    int "Reserved DRAM for AIT Camera driver. (unit: Mega Byte)"
    range 6 72
    default "12"
    help
	Set reserved DRAM for AIT camera driver (unit: Mega Byte)

choice
	prompt "Select a UART for early kernel messages"

config AT91_EARLY_DBGU
	bool "DBGU"

config AIT_EARLY_USART0
	bool "Select ttyS0"

config AIT_EARLY_USART1
	bool "Select ttyS1"

config AIT_EARLY_USART2
	bool "Select ttyS2"

config AIT_EARLY_USART3
	bool "Select ttyS3"
endchoice

endmenu

endif # ARCH_MCRV2
```

## arch/arm/mach-mcrv2/cpucomm/Kconfig
```kconfig
menu "Dual CPU Support"

choice
    prompt "DUAL CPU SETUP"

config AIT_MCRV2_DUAL_OS_DISABLE
	bool "Run on CPUA of AIT8428 (Uni-Mode)"
	#default N
	help
	  This config chose CPUA of AIT8428(Mercury V2) to run Linux.

config AIT_MCRV2_DUAL_OS_ON_CPUA
	bool "Run on CPUA of AIT8428 (Master-Mode)"
	#default Y
	help
	  This config chose CPUA of AIT8428(Mercury V2) to run Linux.
	
config AIT_MCRV2_DUAL_OS_ON_CPUB
	bool "Run on CPUB of AIT8428 (Slave Mode)"
	#default N
	help
	  This config chose CPUB of AIT8428(Mercury V2) to run Linux. 
endchoice


#if AIT_MCRV2_DUAL_OS_ON_CPUA


config AIT_CPUB_BOOT_DRIVER
	tristate "Boot CPUB by CPUA of AIT8428"
	
	depends on AIT_MCRV2_DUAL_OS_ON_CPUA 
	default m
	help
	  This config chose CPUA of AIT8428(Mercury V2) to run Linux.

config AIT_CPUB_BOOTCODE_PATH
	depends on AIT_CPUB_BOOT_DRIVER
	string "CPUB Boot code path"
	default "/etc/firmware/ITCM_EXE_UCOS2"
	---help---
	  Path to the boot code for CPUB.

config AIT_CPUB_FW_PATH
	depends on AIT_CPUB_BOOT_DRIVER
	string "CPUB firmware path"
	default "/etc/firmware/ALL_DRAM_UCOS2"
	---help---
	  Path to the firmware for CPUB.

config AIT_CPUB_CMD_THD
	tristate "Enable kernel thread to process cpub command"
	depends on AIT_CPUB_BOOT_DRIVER
	help
	  If you want cpub to read/write file. This configure must enable
	  
	comment "CPUB Driver Support"	  
config AIT_CPUB_DRIVER_MD
	tristate "Enable MD driver run on CPUA of AIT8428"
	
	depends on AIT_MCRV2_DUAL_OS_ON_CPUA && AIT_CPUB_BOOT_DRIVER
	default m
	help
	  This config chose CPUA of AIT8428(Mercury V2) to run Linux.

config AIT_CPUB_DRIVER_AAC
	tristate "Enable AAC driver run on CPUA of AIT8428"
	
	depends on AIT_MCRV2_DUAL_OS_ON_CPUA && AIT_CPUB_BOOT_DRIVER
	default m
	help
	  This config chose CPUA of AIT8428(Mercury V2) to run Linux.

config AIT_CPUB_DRIVER_AES
	tristate "Enable AES driver run on CPUA of AIT8428"
	
	depends on AIT_MCRV2_DUAL_OS_ON_CPUA && AIT_CPUB_BOOT_DRIVER
	default m
	help
	  This config chose CPUA of AIT8428(Mercury V2) to run Linux.



#endif # AIT_MCRV2_DUAL_OS_ON_CPUA

endmenu
```

## arch/arm/mach-vsnv3/Kconfig
```kconfig
if ARCH_VSNV3

menu "AIT MMP System-on-Chip"

choice
	prompt "AIT MMP Processors"

config ARCH_VSNV3AIT845X
	bool "AIT845X"
	select CPU_ARM926T
	select GENERIC_CLOCKEVENTS
	select HAVE_NET_MACB
	select WIRELESS_EXT
	select WEXT_PRIV

endchoice

choice
    prompt "AIT CHIP Name"

config AIT_CHIP_VSN_V3
    bool "VSN_V3"

config AIT_CHIP_MCR_V2
    bool "MCR_V2"

config AIT_CHIP_MCR_V2_MP
    bool "MCR_V2_MP"

endchoice

# ----------------------------------------------------------

if ARCH_VSNV3AIT845X

comment "AIT845X Board Type"

if AIT_CHIP_VSN_V3
config MACH_VSNV3_AIT8455EVB
	bool "AIT AIT8455EVB Evaluation Kit"
	depends on ARCH_VSNV3
	help
	  Select this if you are using AIT's AIT8455 Evaluation Kit
endif
endif
#-----------------------
if AIT_CHIP_MCR_V2 || AIT_CHIP_MCR_V2_MP 

choice
	prompt "Select AIT8428 Board"

config MACH_MCRV2_AIT8428EVB
    bool "AIT8428EVB Evaluation Kit"

config MACH_MCRV2_LOT8428EVB
    bool "LOT8428EVB Evaluation Kit"

endchoice
	  
endif #AIT_CHIP_MCR_V2
#------------------------


# ----------------------------------------------------------

comment "VSNV3 Feature Selections"

source "arch/arm/mach-vsnv3/cpucomm/Kconfig"

config G0_CLOCK_HZ
	int "Group 0 clock in KHz" if MMU
	depends on AIT_CHIP_MCR_V2 || AIT_CHIP_MCR_V2_MP || AIT_CHIP_VSN_V3
	default 2000000
	help
	  Please provide the group 0 clock setting to the system.

config AIT_ENABLE_JTAG
	bool "Enable JTAG"
	help
	  Select this if you need enable JTAG support.	

# ----------------------------------------------------------

comment "VSNV3 Feature Selections"

config VSNV3_TIMER_HZ
       int "Kernel HZ (jiffies per second)"
       range 32 1024
       depends on ARCH_VSNV3
       default "100"
       help
	  On AT91rm9200 chips where you're using a system clock derived
	  from the 32768 Hz hardware clock, this tick rate should divide
	  it exactly: use a power-of-two value, such as 128 or 256, to
	  reduce timing errors caused by rounding.

	  On AT91sam926x chips, or otherwise when using a higher precision
	  system clock (of at least several MHz), rounding is less of a
	  problem so it can be safer to use a decimal values like 100.

config AIT_VIDEO_RESERVED_SIZE
    int "Reserved DRAM for AIT Camera driver"
    range 6291456 25165824
    depends on ARCH_VSNV3 && VIDEO_AIT_CAMERA
    default "12582912"


choice
	prompt "Select a UART for early kernel messages"

config AT91_EARLY_DBGU
	bool "DBGU"

config AIT_EARLY_USART0
	bool "Select ttyS0"

config AIT_EARLY_USART1
	bool "Select ttyS1"

config AIT_EARLY_USART2
	bool "Select ttyS2"

config AIT_EARLY_USART3
	bool "Select ttyS3"
endchoice

endmenu

endif # ARCH_VSNV3
```

## drivers/cpucomm/Kconfig
```kconfig
#
# CPUCOMM subsystem configuration
#

menuconfig CPUCOMM
	tristate "CPUCOMM support"
	depends on HAS_IOMEM
	---help---
	  CPUCOMM support

if CPUCOMM

config CPUCOMM_DUMMY
	boolean "dummy"
	default y
	help
	  dummy

endif # CPUCOMM

config CPU_SHARE_MEM
        tristate "CPUCOMM with share memory support"
        depends on HAS_IOMEM 
        ---help---
	  Using share memory to do the commuication of two cpus.

config CPU_SHARE_MEM_TEST
	tristate "Test share memory"
	depends on CPU_SHARE_MEM
	---help---
		Using Test Share memory
```

## drivers/net/ethernet/asix/Kconfig
```kconfig
#
# ASIX device configuration
#
config NET_VENDOR_ASIX
        bool "Asix devices"
        default y
        depends on ARM
        ---help---
          Choose Asix Ethernet chipset support.

if NET_VENDOR_ASIX

config AX88796C
	tristate "AX88796C support"
	depends on ARM
	select CRC32
	select NET_CORE
	select MII
	---help---
	  Support for AX88796C chipset.

	  To compile this driver as a module, choose M here.  The module
	  will be called AX88796C.

config AX88772C
	tristate "AX88772C support"
	depends on ARM
	select CRC32
	select NET_CORE
	select MII
	---help---
	  Support for AX88772C chipset.

	  To compile this driver as a module, choose M here.  The module
	  will be called AX88772C.

endif #NET_VENDOR_ASIX
```

## drivers/net/iot/Kconfig
```kconfig
#
# Ethernet LAN device configuration
#

menuconfig IOT
	bool "IOT driver support"
	depends on NET
	default y
	---help---
	  This section contains all the Ethernet device drivers.

if IOT




source "drivers/net/iot/mtk/Kconfig"

source "drivers/net/iot/ti/Kconfig"


config SUPPORT_2WAY_SPI
	tristate "2 Way SPI support"
	depends on IOT && MT7687

	---help---
	  Support for 2 Way SPI to TX & RX Ethernet packet from IoT


endif # IOT
```

## drivers/net/iot/mtk/Kconfig
```kconfig
#
# MTK IoT device configuration
#

menuconfig IOT_MTK
	tristate "MTK IoT Device support"

if IOT_MTK
comment "MTK IoT device drivers"
config MT7687
	tristate "MT7687 support"
	depends on ARM
	select NET_CORE
	select SPI
	---help---
	  Support for MT7687 chipset.

	  To compile this driver as a module, choose M here.  The module
	  will be called mt7687.

config MT7682
	tristate "MT7682 support"
	depends on ARM
	select NET_CORE
	select SPI
	default y
	---help---
	  Support for MT7682 chipset.

	  To compile this driver as a module, choose M here.  The module
	  will be called mt7682.

#endchoice
endif
```

## drivers/net/iot/ti/Kconfig
```kconfig
#
# ST device configuration
#

config CC3200
	tristate "CC3200 support"
	depends on ARM
	select NET_CORE
	select SPI
	---help---
	  Support for CC3200 chipset.
```
